#if (SUBCORE != 1)  // SubCoreの指定
#error "Core selection is wrong!!"
#endif

#include <MP.h>
#include <vector>

using namespace std;
class Touch_Sensor
{
  private:
  //pin番号
    const uint8_t SRCLK = 2;
    const uint8_t RCLK = 3;
    const uint8_t G = 4;
    const uint8_t SER = 5;
    const uint8_t input_pin = 6;


  public:
    struct Touch_data
    {
        uint8_t note;
        vector<uint8_t> touch_number;
    };
  //初期設定
    void setup();
  //タッチセンサ処理
    void get_sensor(bool setup);
  //押されたタッチセンサ番号
    vector<uint8_t> touch_number;
};

void Touch_Sensor::setup() 
{
    pinMode(SRCLK, OUTPUT);//SRCLK
    pinMode(RCLK,  OUTPUT);//RCLK
    pinMode(SER,   OUTPUT);//SER
    pinMode(G,   OUTPUT);//G
    pinMode(input_pin, INPUT);//input_pin

    for(uint8_t j = 0; j < 10; j++)
        get_sensor(true);
    Serial.println("touch sensor set up completed !");
}

void Touch_Sensor::get_sensor(bool setup)
{
    //タッチセンサの数
    static int8_t touch_num = 88;
    static uint8_t touch_flag[88];
  //閾値
    static uint8_t touch_threshold[88] = {0};
  //タッチセンサの初期化
    for(uint8_t i = 0; i < touch_num; i++)
        touch_flag[i] = 0;
    touch_number.clear();

    delayMicroseconds(150);
    // 入力状態をHIGHにする
    digitalWrite(SER, HIGH);

    for (uint8_t i=0; i<touch_num; i++) {

        // 閾値決定のための変数
        uint8_t sub_threshold = 1;

        // シフトレジスタをシフトさせてSERピンの状態を記憶させる
        digitalWrite(SRCLK, LOW);
        delayMicroseconds(2);
        digitalWrite(SRCLK, HIGH);
        
        // シフトレジスタの状態をストレージレジスタへ反映させる
        digitalWrite(RCLK,  LOW);
        delayMicroseconds(2);
        digitalWrite(RCLK,  HIGH);

        //出力を有効にする
        digitalWrite(G, LOW);
        
        while(digitalRead(input_pin) != HIGH)
        {
            if (setup)
            {
                sub_threshold++;
            }
            else
            {
                touch_flag[i]++;
            }
        }
        if (setup)
        {
            //最大値を閾値とする
            if(sub_threshold > touch_threshold[i]){
                touch_threshold[i] = sub_threshold;
            }            
        }
        else
        {
            if(touch_flag[i] > touch_threshold[i])
            {
                touch_number.push_back(i); 
            }
        }

        delayMicroseconds(50);

        //出力を無効にする
        digitalWrite(G, HIGH);
        
        // 放電するまで待つ
        delayMicroseconds(200);

        // 以降の入力状態をLOWにする
        digitalWrite(SER, LOW);
    }
    // 閾値確認用
    // for(int j=0;j<88;j++){
    //   printf("%d,"touch_threshold[j]);
    // }
    // printf("\n");
}
///////////////////////////////////////////////////////////////////////////////////////////////////////////////////////
const uint16_t code_mode_size = 109;
const Touch_Sensor::Touch_data code_mode[109] = {
    {1, {}},
    {11, {0}},
    {12, {1}},
    {13, {2}},
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    {129, {70,71}}
};
/////////////////////////////
const uint16_t manual_mode_size = 225;
const Touch_Sensor::Touch_data manual_mode[225] = {
    {1, {}},
    {11, {3,4,8,13}},
    {11, {42,51,52,56}},
    {12, {13,20,22,27}},
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    {129, {36,37,38,39,40,41,49,51}}
};

////////////////////////////////////////////////////////////////////////////////////////////////////////////////////////////////////
Touch_Sensor touch_sensor;
#define Swich_11 (11)
int8_t   ret1;
void setup() 
{
    // シリアル通信設定
    Serial.begin(2000000);
    while (!Serial);
    touch_sensor.setup();
    pinMode(Swich_11, INPUT);

    // マルチコア起動
    ret1 = MP.begin();
    MP.RecvTimeout(MP_RECV_POLLING);   
    //　起動エラー
    // if (ret1 < 0) 
    //     printf("SubCore start error = %d\n", ret1);
}

void loop()
{
    uint16_t note = 10000;
    //タッチセンサの値を取得
    touch_sensor.get_sensor(false);
//    printf("touch_number:");
//    for(uint8_t i=0;i<touch_sensor.touch_number.size();i++)
//    {
//        printf("%d,",touch_sensor.touch_number[i]);
//    }
//    printf("\n");
    
    //対応した音の番号の出力
    bool Code_mode = digitalRead(Swich_11);
    if(Code_mode)
    {
        for(uint8_t i=0;i<code_mode_size;i++)
        {
            if(touch_sensor.touch_number.size() == code_mode[i].touch_number.size() && 
            equal(touch_sensor.touch_number.cbegin(),touch_sensor.touch_number.cend(),code_mode[i].touch_number.cbegin()))
            {
                note = code_mode[i].note;
                break;
            }
            
        }
    }
    else
    {
        for(uint8_t i=0;i<manual_mode_size;i++)
        {
            if(touch_sensor.touch_number.size() == manual_mode[i].touch_number.size() && 
            equal(touch_sensor.touch_number.cbegin(),touch_sensor.touch_number.cend(),manual_mode[i].touch_number.cbegin()))
            {
                note = manual_mode[i].note;
                break;
            }
        }
    }
    int8_t msgid;
    uint32_t msgdata;
    /* Echo back */
    ret1 = MP.Recv(&msgid, &msgdata);  // MainCoreからmsg受信
    if (ret1 < 0) {
        //printf("SubCore1 fail connect Main = %d\n", ret1);
    }
    else
    {
        msgdata = note;
        ret1 = MP.Send(msgid, msgdata);  
         //msg送信エラー
         if (ret1 < 0) 
            printf("SubCore 1 send error = %d\n", ret1);
         else
            printf("SubCore1 send: id=%d data=%d\n", msgid, msgdata);
    }
    return;
}
